/*
 * modbus.c
 *
 *  Created on: 6 февр. 2024 г.
 *      Author: 5095
 */

/******************************************************************************
** Название модуля:		modbus.c
**
** Описание:	данный модуль предназначен для реализации обмена информацией по протоколу ModBus.
** При помощи данного модуля в основной программе ПВЦ-08 реализуется обмен информацией с Шлюзом 1,Шлюзом 2, АОПом и БНО-01 .
**
** дата создания:	        04.07.2011
** версия:	                v.1.0
**
******************************************************************************/
#include "type.h"
#include "modbus.h"



struct strMBtable  {
 WORD adr;
 WORD *adrptr;
} MBtable [MBmaxpars];

WORD *FLASHtable [FLASHmaxpars]; //Таблица параметров для записи в FLASH
WORD FLASHbuf	[FLASHmaxpars+1];	//Блок памяти для чтения и записи в FLASH

int MBcntpars = 0; //Счетчик параметров
int FLASHcntpars = 0; //Счетчик параметров в FLASH
int cntpang = 0; //Счетчик пакетов от пан

/******************************************************************************
** Имя функции:		FLASHregfloat
**
** Описание:	Функция регистрации переменной FLOAT для записи в FLASH
**
** Параметры:	            float *adr - указатель на адрес переменной
** Возвращаемое значение:	нет
**
******************************************************************************/
void FLASHregfloat (float *adr)
{WORD *p;
 p = (WORD*)adr;
 FLASHtable [FLASHcntpars] = p;
 FLASHcntpars++;
 p++;

 FLASHtable [FLASHcntpars] = p;
 FLASHcntpars++;
};

/******************************************************************************
** Имя функции:		FLASHregword
**
** Описание:	Функция регистрации переменной WORD для записи в FLASH
**
** Параметры:	            WORD *adr - указатель на адрес переменной
** Возвращаемое значение:	нет
**
******************************************************************************/
void FLASHregword (WORD *adr)
{
WORD *p;
 p = (WORD*)adr;
 FLASHtable [FLASHcntpars] = p;
 FLASHcntpars++;
};

/******************************************************************************
** Имя функции:		FLASHreglong
**
** Описание:	Функция регистрации переменной DWORD для записи в FLASH
**
** Параметры:	            DWORD *adr - указатель на адрес переменной
** Возвращаемое значение:	нет
**
******************************************************************************/
void FLASHreglong (DWORD *adr)
{WORD *p;
 p = (WORD*)adr;
 FLASHtable [FLASHcntpars] = p;
 FLASHcntpars++;
 p++;

 FLASHtable [FLASHcntpars] = p;
 FLASHcntpars++;
};

/******************************************************************************
** Имя функции:		FLASHregint
**
** Описание:	Функция регистрации переменной short int для записи в FLASH
**
** Параметры:	            DWORD *adr - указатель на адрес переменной
** Возвращаемое значение:	нет
**
******************************************************************************/
void FLASHregint (short int *adr)
{
WORD *p;
 p = (WORD*)adr;
 FLASHtable [FLASHcntpars] = p;
 FLASHcntpars++;
};

/******************************************************************************
** Имя функции:		FLASHsavetobuf
**
** Описание:	Функция, сохраняющая зарегистрированные параметры в FLASH
**
** Параметры:	            нет
** Возвращаемое значение:	нет
**
******************************************************************************/
void FLASHsavetobuf (void)
{int i; WORD crc, *p;

 crc = 0;
 for (i=0;i<FLASHcntpars;i++)
  {p = FLASHtable [i];
   FLASHbuf [i] = *p;
   crc += *p;
  }
 FLASHbuf [FLASHcntpars] = crc;
}

/******************************************************************************
** Имя функции:		FLASHcheck
**
** Описание:	Функция, проверяющая прочитанные параметры из FLASH
**
** Параметры:	            нет
** Возвращаемое значение:	возвращает контрольную сумму прочитанных параметров
**
******************************************************************************/
int FLASHcheck ()
{int i;
WORD crc;
 crc = 0;
 for (i=0;i<FLASHcntpars;i++) crc += FLASHbuf [i];
 return FLASHbuf [FLASHcntpars] == crc;
};

/******************************************************************************
** Имя функции:		FLASHrestore
**
** Описание:	Функция, востанавливающая прочитанные переменные из FLASH в параметры
**
** Параметры:	            нет
** Возвращаемое значение:	нет
**
******************************************************************************/
void FLASHrestore ()
{int i; WORD *p;
 for (i=0;i<FLASHcntpars;i++)
 {p = FLASHtable [i];
  *p = FLASHbuf [i];
 };
};

//Функции работы с буфером
/******************************************************************************
** Имя функции:		addwordtobuf
**
** Описание:	Функция, добавляющая в байтовый буфер переменную типа WORD
**
** Параметры:	            BYTE buf[] - заполняемый буфер;
**                          int *pos - номер элемента буфера;
**                          WORD w - переменная, добавляемая в буфер
** Возвращаемое значение:	нет
**
******************************************************************************/
void addwordtobuf (BYTE buf[], int *pos, WORD w)
{
 buf [*pos] = w >> 8;   (*pos)++;
 buf [*pos] = w & 0xFF; (*pos)++;
};
/******************************************************************************
** Имя функции:		adddwordtobuf
**
** Описание:	Функция, добавляющая в байтовый буфер переменную типа DWORD
**
** Параметры:	            BYTE buf[] - заполняемый буфер;
**                          int *pos - номер элемента буфера;
**                          DWORD dw - переменная, добавляемая в буфер
** Возвращаемое значение:	нет
**
******************************************************************************/
void adddwordtobuf (BYTE buf[], int *pos, DWORD dw)
{
 buf [*pos] = dw >> 24;  (*pos)++;
 buf [*pos] = dw >> 16;  (*pos)++;
 buf [*pos] = dw >> 8;   (*pos)++;
 buf [*pos] = dw & 0xFF; (*pos)++;
};
/******************************************************************************
** Имя функции:		addfloattobuf
**
** Описание:	Функция, добавляющая в байтовый буфер переменную типа float
**
** Параметры:	            BYTE buf[] - заполняемый буфер;
**                          int *pos - номер элемента буфера;
**                          float f - переменная, добавляемая в буфер
** Возвращаемое значение:	нет
**
******************************************************************************/
void addfloattobuf (BYTE buf[], int *pos, float f)
{
 union {
 float F;
 BYTE B[4];
 } FB;

 FB. F = f;
 buf [*pos] = FB. B [0]; (*pos)++;
 buf [*pos] = FB. B [1]; (*pos)++;
 buf [*pos] = FB. B [2]; (*pos)++;
 buf [*pos] = FB. B [3]; (*pos)++;
};

/******************************************************************************
** Имя функции:		getwordfrombuf
**
** Описание:	Функция, распаковывающая из байтового буфера данные в переменную типа WORD
**
** Параметры:	            BYTE buf[] - байтовый буфер, в который запакованы данные;int *pos - номер элемента буфера;
** Возвращаемое значение:	WORD W - значение параметра, полученное при распаковке
**
******************************************************************************/
WORD getwordfrombuf (BYTE buf[], int *pos)
{WORD W;
 W = ((WORD)buf [*pos]) << 8;   (*pos)++;
 W |= buf [*pos]; (*pos)++;
 return W;
};
/******************************************************************************
** Имя функции:		getdwordfrombuf
**
** Описание:	Функция, распаковывающая из байтового буфера данные в переменную типа DWORD
**
** Параметры:	            BYTE buf[] - байтовый буфер, в который запакованы данные;
**                          int *pos - номер элемента буфера;
** Возвращаемое значение:	DWORD dw - значение параметра, полученное при распаковке
**
******************************************************************************/
DWORD getdwordfrombuf (BYTE buf[], int *pos)
{DWORD dw;
 dw =  ((DWORD)buf [*pos]) << 24;  (*pos)++;
 dw |= ((DWORD)buf [*pos]) << 16;  (*pos)++;
 dw |= ((DWORD)buf [*pos]) << 8;  (*pos)++;
 dw |= ((DWORD)buf [*pos]);  (*pos)++;
 return dw;
};
/******************************************************************************
** Имя функции:		getfloatfrombuf
**
** Описание:	Функция, распаковывающая из байтового буфера данные в переменную типа float
**
** Параметры:	            BYTE buf[] - байтовый буфер, в который запакованы данные;
**                          int *pos - номер элемента буфера;
** Возвращаемое значение:	значение параметра, полученное при распаковке
**
******************************************************************************/
float getfloatfrombuf (BYTE buf[], int *pos)
{
 union {
 float F;
 BYTE B[4];
 } FB;

 FB. B [0] = buf [*pos]; (*pos)++;
 FB. B [1] = buf [*pos]; (*pos)++;
 FB. B [2] = buf [*pos]; (*pos)++;
 FB. B [3] = buf [*pos]; (*pos)++;
 return FB.F;
};

/******************************************************************************
** Имя функции:		getwordbyadr
**
** Описание:	Функция, cчитывающая переменную типа WORD из списка, расположенную по заданному адресу
**
** Параметры:	            WORD ADR - адрес, по которому считываются данные
** Возвращаемое значение:	WORD W - прочитанное значение переменной; возвращает значение 1111, если такой адрес в списке не обнаружен
**
******************************************************************************/
WORD getwordbyadr (WORD ADR)
{WORD W, i, *p;
 W = 0x1111;
 for (i=0;i<MBcntpars;i++)
  if (MBtable [i]. adr == ADR) {p = MBtable [i]. adrptr; W = *p;};
 return W;
};

/******************************************************************************
** Имя функции:		MBregfloat
**
** Описание:	Функция, регистрирующая параметр типа float в таблицу для чтения или записи по протоколу ModBus
**
** Параметры:	            float *adr - указатель на адрес регестрироемой переменной
**                          WORD adrw  - адрес в таблице
**							int f_FLASH - статус необходимости сохранения значения параметра в FLASH
** Возвращаемое значение:	нет
**
******************************************************************************/
void MBregfloat (float *adr, WORD adrw, int f_FLASH)
{WORD *p;
 if (f_FLASH) FLASHregfloat (adr);
 p = (WORD*)adr;
 MBtable [MBcntpars]. adr      = adrw; //прямой порядок
 MBtable [MBcntpars]. adrptr = p;
 MBcntpars++;
 p++;

 MBtable [MBcntpars]. adr      = adrw+2;
 MBtable [MBcntpars]. adrptr = p;
 MBcntpars++;
};


/******************************************************************************
** Имя функции:		MBreglong
**
** Описание:	Функция, регистрирующая параметр типа DWORD в таблицу для чтения или записи по протоколу ModBus
**
** Параметры:	            DWORD *adr - указатель на адрес регестрироемой переменной
**                          WORD adrw  - адрес в таблице
**							int f_FLASH - статус необходимости сохранения значения параметра в FLASH
** Возвращаемое значение:	нет
**
******************************************************************************/
void MBreglong (DWORD *adr, WORD adrw, int f_FLASH)
{WORD *p;
 if (f_FLASH) FLASHreglong (adr);
 p = (WORD*)adr;
 MBtable [MBcntpars]. adr      = adrw;//обратный порядок
 MBtable [MBcntpars]. adrptr = p;
 MBcntpars++;
 p++;

 MBtable [MBcntpars]. adr      = adrw+2;
 MBtable [MBcntpars]. adrptr = p;
 MBcntpars++;
};
/******************************************************************************
** Имя функции:		MBregint
**
** Описание:	Функция, регистрирующая параметр типа short int в таблицу для чтения или записи по протоколу ModBus
**
** Параметры:	            short int *adr - указатель на адрес регестрироемой переменной
**                          WORD adrw  - адрес в таблице
**							int f_FLASH - статус необходимости сохранения значения параметра в FLASH
** Возвращаемое значение:	нет
**
******************************************************************************/
void MBregint (short int *adr, WORD adrw, int f_FLASH)
{if (f_FLASH) FLASHregint (adr);
 MBtable [MBcntpars]. adr      = adrw;
 MBtable [MBcntpars]. adrptr = (WORD*)adr;
 MBcntpars++;
};
/******************************************************************************
** Имя функции:		MBregword
**
** Описание:	Функция, регистрирующая параметр типа short int в таблицу для чтения или записи по протоколу ModBus
**
** Параметры:	            short int *adr - указатель на адрес регестрироемой переменной
**                          WORD adrw  - адрес в таблице
**							int f_FLASH - статус необходимости сохранения значения параметра в FLASH
** Возвращаемое значение:	нет
**
******************************************************************************/
void MBregword (WORD *adr, WORD adrw, int f_FLASH)
{if (f_FLASH) FLASHregword (adr);
 MBtable [MBcntpars]. adr    = adrw;
 MBtable [MBcntpars]. adrptr = adr;
 MBcntpars++;
};

/******************************************************************************
** Имя функции:		MBresend
**
** Описание:	Функция заполнения таблицы параметров данными из буфера для отправки по протоколу ModBus
**
** Параметры:	            BYTE buffer [] - буфер,  из которого распаковываются данные
**                          BYTE data [] - буфер, в который	запаковываются значения параметров из таблицы
**							int *pos - номер в буфере
** Возвращаемое значение:	нет
**
******************************************************************************/
void MBresend (BYTE buffer [], BYTE data [],int *pos)
{int i, cnt;

 cnt = ((WORD)buffer [2] << 8) + buffer [3];

 /* В содержимое ответного сообщения добавляем номер пакета при запросе */
// data [*pos] = buffer [0]; *pos = *pos + 1;
// data [*pos] = buffer [1]; *pos = *pos + 1;

 for (i=0;i<cnt;i++)
 {
	 data [*pos] = buffer [i]; *pos = *pos + 1;

 };
};
/******************************************************************************
** Имя функции:		MBwritedata
**
** Описание:	Функция заполнения таблицы параметров данными из буфера для отправки по протоколу ModBus
**
** Параметры:	            BYTE buffer [] - буфер,  из которого распаковываются данные
**                          BYTE data [] - буфер, в который	запаковываются значения параметров из таблицы
**							int *pos - номер в буфере
** Возвращаемое значение:	нет
**
******************************************************************************/
void MBwritedata (BYTE buffer [], BYTE data [],int *pos)
{int i, j, cnt;
 WORD *p, W, ADR;

 // cnt = ((WORD)buffer [2] << 8) + buffer [3]; // получаем количество параметров (2 байта)
  cnt = ((WORD)buffer [0] << 8) + buffer [1]; // получаем количество параметров (2 байта)
  if (cnt>20) cnt=0;  //Защита от переполнения выходного буфера

 /* В содержимое ответного сообщения добавляем номер пакета при запросе */
 data [*pos] = buffer [0]; *pos = *pos + 1;
 data [*pos] = buffer [1]; *pos = *pos + 1;

 for (i=0;i<cnt;i++)
 {
  ADR = ((WORD)buffer [2+i*4] << 8)   + buffer [2+i*4+1]; // при  запросах на запись настроек адреса параметров начитнаются с 4 байта в поле "Данные"
  W   = ((WORD)buffer [2+i*4+2] << 8) + buffer [2+i*4+3];
  for (j=0;j<MBcntpars;j++)
   if (MBtable [j]. adr == ADR) {p = MBtable [j]. adrptr; *p = W;}

 };
};
/******************************************************************************
** Имя функции:		MBreaddata
**
** Описание:	Функция считывания информации из буфера, принятого по протоколу ModBus, в таблицу параметров
**
** Параметры:	            BYTE buffer [] - буфер, из которого распаковываются данные
**							BYTE data [] - буфер, в который	запаковываются значения параметров из таблицы
**							int *pos - номер в буфере
** Возвращаемое значение:	нет
**
******************************************************************************/
void MBreaddata (BYTE buffer [], BYTE data [],int *pos)
{int i, j, f, cnt;
 WORD *p, ADR;
// cnt = ((WORD)buffer [2] << 8) + buffer [3]; // получаем количество параметров (2 байта)
 cnt = ((WORD)buffer [0] << 8) + buffer [1]; // получаем количество параметров (2 байта)
 if (cnt>20) cnt=0;  //Защита от переполнения выходного буфера

 /* В содержимое ответного сообщения добавляем номер пакета при запросе */
 data [*pos] = buffer [0]; *pos = *pos + 1;
 data [*pos] = buffer [1]; *pos = *pos + 1;
 data [*pos] = buffer [2]; *pos = *pos + 1;
 data [*pos] = buffer [3]; *pos = *pos + 1;

 for (i=0;i<cnt;i++)
 {f = 1;
  ADR = ((WORD)buffer [2+i*2] << 8) + buffer [2+i*2+1];
  //ADR = ((WORD)buffer [4+i*2] << 8) + buffer [4+i*2+1];
  for (j=0;j<MBcntpars;j++)
  {
   if (MBtable [j]. adr == ADR)
   {p = MBtable [j]. adrptr;
    data [*pos] = (*p) >> 8; *pos = (*pos) + 1;
    data [*pos] = (*p) & 0xFF; *pos = (*pos) + 1;
	f = 0;}
  };
   if (f)
   {data [*pos] = 0x11; *pos = (*pos) + 1;
    data [*pos] = 0x11; *pos = (*pos) + 1;};
 };
};
/******************************************************************************
** Имя функции:		getchar
**
** Описание:	Функция преобразования байта в символ
**
** Параметры:	            BYTE B - байт для преобразования
** Возвращаемое значение:	код полученного в результате преобразования символа
**
******************************************************************************/
unsigned char getchar (BYTE B)
{
 B = B & 0x0F;
 if (B < 10) B = B + '0'; else B = B + 'A' - 10;
 return B;
};
/******************************************************************************
** Имя функции:		MBpackID
**
** Описание:	Функция чтения идентификационного кода сообщения
**
** Параметры:	            BYTE tpFRAME - код типа фрейма
**							BYTE idLIST - идентификационный номер списка параметров
**							BYTE numFRAME - номер фрейма
**							BYTE adrNODE - адрес устройства
** Возвращаемое значение:	WORD D - переменная с записанным идентификатором сообщения
**
******************************************************************************/
WORD MBpackID (BYTE tpFRAME, BYTE idLIST, BYTE numFRAME, BYTE adrNODE)
{WORD D;
 D = tpFRAME & 0x07;
 D = (D << 4) | (idLIST & 0x0F);
 D = (D << 5) | (numFRAME & 0x1F);
 D = (D << 4) | (adrNODE = adrNODE & 0x0F);

 return D;
};
/******************************************************************************
** Имя функции:		MBunpackID
**
** Описание:	Функция распаковки идентификационного кода сообщения
**
** Параметры:	            WORD MBID - идентификатор сообщения
**                          BYTE *tpFRAME - указатель на переменную, в которую записывается значения типа фрейма
**							BYTE *idLIST - указатель на переменную, в которую записывается идентификационный номер списка параметров
**							BYTE *numFRAME - указатель на переменную, в которую записывается номер фрейма
**							BYTE *adrNODE - указатель на переменную, в которую записывается адрес устройства
** Возвращаемое значение:	нет
**
******************************************************************************/
void MBunpackID (WORD MBID, BYTE *tpFRAME, BYTE *idLIST, BYTE *numFRAME, BYTE *adrNODE)
{
 *adrNODE = MBID & 0x0F; MBID = MBID >> 4;
 *numFRAME = MBID & 0x1F; MBID = MBID >> 5;
 *idLIST = MBID & 0x0F; MBID = MBID >> 4;
 *tpFRAME = MBID & 0x07;
};

/******************************************************************************
** Имя функции:		MBpack
**
** Описание:	Функция формирования сообщения, передаваемого по протоколу ModBus
**
** Параметры:	            BYTE ADR - адрес устройства, которому передается сообщение
**                          BYTE FUNC - номер функции согласно протоколу ModBus
**							BYTE pack[] - буфер с данными, которые должны быть переданы
**							int inlen - длина входного буфера данных
**							BYTE buffer[] - буфер, который формируется в формате выбранного протокола из входного буфера
							int *outlen - длина выходного буфера
** Возвращаемое значение:	нет
**
******************************************************************************/
void MBpack (BYTE ADR, BYTE FUNC, BYTE pack[], int inlen, BYTE buffer[], int *outlen)
{int LRC, i;
//передаем начало
 *outlen = 0;
 *buffer = ':';                 buffer++; *outlen += 1;
 *buffer = getchar (ADR >> 4);  buffer++; *outlen += 1;
 *buffer = getchar (ADR);       buffer++; *outlen += 1;
 *buffer = getchar (FUNC >> 4); buffer++; *outlen += 1;
 *buffer = getchar (FUNC);      buffer++; *outlen += 1;
 LRC = ADR + FUNC;
 //передаем данные
for (i = 0;i<inlen;i++)
{*buffer = getchar (pack [i] >> 4);    buffer++; *outlen += 1;
 *buffer = getchar (pack [i] & 0x0F);  buffer++; *outlen += 1;
 LRC += pack [i];
}
 //считаем контрольную сумму
  LRC = (~LRC+1)&0xFF;
//передаем контрольную сумму
 *buffer = getchar (LRC >> 4);  buffer++; *outlen += 1;
 *buffer = getchar (LRC);       buffer++; *outlen += 1;
//передаем финальные символы
 *buffer = 13;       buffer++; *outlen += 1;
 *buffer = 10;       buffer++; *outlen += 1;
}
/******************************************************************************
** Имя функции:		MBunpack
**
** Описание:	Функция расформирования сообщения, передаваемого по протоколу ModBus
**
** Параметры:	    BYTE buffer [] - буфер, который был принят по протоколу ModBus
**                  int *inlen - длина буфера
**					BYTE *ADR - указатель на переменную, в которую записывается адрес устройства, которому передано сообщение
**					BYTE *FUNC - указатель на переменную, в которую записывается номер функции принимаемого сообщения
**					int *f_done - идентификатор корректного приема сообщения
** Возвращаемое значение:	нет
**
******************************************************************************/
void MBunpack (BYTE buffer [], int *inlen, BYTE *ADR, BYTE *FUNC, int *f_done)
{int LRC, i;
//передаем начало
// sprintf (buf, "intlen first = %05d  \n\r", intlen); UART0sendbuf (buf, strlen (buf));
 *ADR  = buffer [0];
 *FUNC = buffer [1];
 //*SPS_major = buffer [2];
 //*SPS_minor = buffer [3];
 LRC = buffer [0] + buffer [1];
 for (i=2;i<*inlen-1;i++)
 {LRC += buffer [i]; buffer [i-2] = buffer [i];};
 LRC = (~LRC+1)&0xFF;
 *f_done = buffer [(*inlen)-1] == LRC;

 *inlen -= 3;
// sprintf (buf, "intlen post = %05d  \n\r", intlen); UART0sendbuf (buf, strlen (buf));
};



/******************************************************************************
** Имя функции:		MBunpack2
**
** Описание:	Функция расформирования сообщения, передаваемого по протоколу ModBus
**
** Параметры:	    BYTE buffer [] - буфер, который был принят по протоколу ModBus
**                  int *inlen - длина буфера
**					BYTE *ADR - указатель на переменную, в которую записывается адрес устройства, которому передано сообщение
**					BYTE *FUNC - указатель на переменную, в которую записывается номер функции принимаемого сообщения
**					int *f_done - идентификатор корректного приема сообщения
** Возвращаемое значение:	нет
**
******************************************************************************/
void MBunpack2 (BYTE buffer2 [], int *inlen2, BYTE *ADR2, BYTE *FUNC2, int *f_done22)
{int LRC2, i2;
//передаем начало
// sprintf (buf, "intlen first = %05d  \n\r", intlen); UART0sendbuf (buf, strlen (buf));
 *ADR2  = buffer2 [0];
 *FUNC2 = buffer2 [1];
 //*SPS_major = buffer [2];
 //*SPS_minor = buffer [3];
 LRC2 = buffer2 [0] + buffer2 [1];
 for (i2=2;i2<*inlen2-1;i2++)
 {LRC2 += buffer2 [i2]; buffer2 [i2-2] = buffer2 [i2];};
 LRC2 = (~LRC2+1)&0xFF;
 *f_done22 = buffer2 [(*inlen2)-1] == LRC2;

 *inlen2 -= 3;
// sprintf (buf, "intlen post = %05d  \n\r", intlen); UART0sendbuf (buf, strlen (buf));
};


